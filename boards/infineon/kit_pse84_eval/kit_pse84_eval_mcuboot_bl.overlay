/*
 * Copyright (c) 2026 Infineon Technologies AG,
 * or an affiliate of Infineon Technologies AG.
 *
 * SPDX-License-Identifier: Apache-2.0
 */

/*
 * DTS overlay applied to the MCUBoot bootloader image only.
 *
 * Overrides the chosen code-partition to boot_partition so that
 * MCUBoot is linked at the RRAM address where the extended boot
 * expects it (0x22011000). All flash slot geometry (slot0..slot5
 * across CBUS-S, CBUS-NS and SAHB) is defined in
 * kit_pse84_eval_memory_map.dtsi so that the bootloader inherits
 * the same view used by the SPE / NSPE / CM55 builds.
 *
 * Console/log stays on SCB1 (MiniProg4 VCOM) via the board default; this
 * overlay only selects SCB2 (uart2, KitProg3 VCOM) as the serial-recovery
 * (mcumgr) UART.
 */
/ {
	chosen {
		zephyr,code-partition = &boot_partition;
		zephyr,flash = &rram0;
		/* DFU / serial recovery over SCB2 (KitProg3). */
		zephyr,uart-mcumgr = &uart2;
	};

	aliases {
		/* SW_1 (P8.3) used as the serial recovery entrance button. */
		mcuboot-button0 = &user_bt;
	};
};

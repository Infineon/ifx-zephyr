/*
 * Copyright (c) 2026 Infineon Technologies AG,
 * or an affiliate of Infineon Technologies AG.
 *
 * SPDX-License-Identifier: Apache-2.0
 */

/*
 * Route the in-app SMP/mcumgr transport to SCB2 (KitProg3 VCOM). Console/log
 * stay on the board-default SCB1 (MiniProg4 VCOM). Slots come from the MCUboot
 * config (kit_pse84_eval_slot.conf).
 */
/ {
	chosen {
		zephyr,uart-mcumgr = &uart2;
	};
};

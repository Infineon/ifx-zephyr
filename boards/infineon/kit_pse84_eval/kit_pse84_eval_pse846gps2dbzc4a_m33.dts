/*
 * SPDX-FileCopyrightText: <text>Copyright (c) 2026 Infineon Technologies AG,
 * or an affiliate of Infineon Technologies AG. All rights reserved.</text>
 *
 * SPDX-License-Identifier: Apache-2.0
 */

/dts-v1/;
#include <infineon/edge/mpns/pse846gps2dbzc4a_s.dtsi>
#include "kit_pse84_eval_pse846gps2dbzc4a_rram.dtsi"
#include "kit_pse84_eval_m33.dtsi"

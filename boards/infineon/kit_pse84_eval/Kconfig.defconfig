## drivers/display/Kconfig.waveshare_4p3
```kconfig
config WAVESHARE_4P3
	bool "Waveshare 4.3in display driver"
	default y
	select I2C
	depends on DT_HAS_WAVESHARE_4P3_ENABLED
	help
	  Enable driver for Waveshare 4.3in display
```

## drivers/rtc/Kconfig.infineon
```kconfig
# Infineon CAT1 RTC configuration options

# Copyright (c) 2024 Cypress Semiconductor Corporation (an Infineon company) or
# an affiliate of Cypress Semiconductor Corporation
#
# SPDX-License-Identifier: Apache-2.0

config RTC_INFINEON_CAT1
	bool "Infineon CAT1 RTC driver"
	default y
	depends on DT_HAS_INFINEON_RTC_ENABLED
	select USE_INFINEON_RTC
	help
	  This option enables the RTC driver for Infineon CAT1 family.

config RTC_INFINEON_SKIP_SECURE_INIT
	bool "Infineon RTC init skip"
	default y if BUILD_WITH_TFM || PSOC_EDGE_M55_SRF_SUPPORT
	help
	  This option limits the scope of the init, if a board's core
	  is running in a nonsecure TF-M state.
```
